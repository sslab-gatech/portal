## drivers/cca/Kconfig
```kconfig
config CCA_MODULE
        tristate "Custom Characteristic Add-on Module"
        default y
        help
          Say Y here if you want to build the Custom Characteristic Add-on Module.
```

## drivers/portal/Kconfig
```kconfig
config CCA_PORTAL
        tristate "Virtual device for portal"
        default y
        help
          Say Y here if you want to build the Custom Characteristic Add-on Module.
```
